## sdkconfig.defaults
```kconfig
# Target
CONFIG_IDF_TARGET="esp32s3"

# CPU
CONFIG_ESP32S3_DEFAULT_CPU_FREQ_240=y
CONFIG_ESP32S3_DEFAULT_CPU_FREQ_MHZ=240

# PSRAM
CONFIG_SPIRAM=y
CONFIG_SPIRAM_MODE_OCT=y
CONFIG_SPIRAM_SPEED_80M=y
CONFIG_SPIRAM_USE_MALLOC=y
CONFIG_SPIRAM_MALLOC_ALWAYSINTERNAL=4096

# LCD
CONFIG_SOC_LCD_RGB_SUPPORTED=y
CONFIG_LCD_RGB_ISR_IRAM_SAFE=n

# Stack
CONFIG_ESP_MAIN_TASK_STACK_SIZE=32768

# Flash
CONFIG_ESPTOOLPY_FLASHSIZE_4MB=y
CONFIG_ESPTOOLPY_FLASHSIZE="4MB"

# Disable unused
CONFIG_BT_ENABLED=n
CONFIG_ESP_WIFI_ENABLED=n

# Compiler
CONFIG_COMPILER_OPTIMIZATION_SIZE=y

# Watchdog
CONFIG_ESP_TASK_WDT_TIMEOUT_S=10
```
